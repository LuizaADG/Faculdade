;************** AULA 01 - PROGRAMA PARA PISCAR LED *****************
LIST   P=PIC16F628A
RADIX DEC	
#INCLUDE <P16F628A.INC>
	__CONFIG _INTRC_OSC_NOCLKOUT & _WDT_OFF & _PWRTE_ON & _BODEN_OFF & _LVP_OFF & _CP_OFF & _MCLRE_OFF & _CPD_OFF 
	;ou __CONFIG H'3F10'

	CBLOCK	0x20	;ENDEREÇO INICIAL DA MEMÓRIA DE
					;USUÁRIO
	CONTADOR1
	CONTADOR2
	CONTADOR3
	CONTADOR4
	CONTADOR5
	ENDC			;FIM DO BLOCO DE MEMÓRIA		
	
	ORG	0x00		;ENDEREÇO INICIAL DE PROCESSAMENTO
	GOTO	INICIO
		
INICIO
	CLRF	PORTA		;LIMPA O PORTA
	CLRF	PORTB		;LIMPA O PORTB
	BSF STATUS, RP0
	CLRF TRISB
	BCF STATUS, RP0

REPETE
	BSF PORTB, 1
	CALL ATRASO
	BCF PORTB, 1
	CALL ATRASO
	GOTO REPETE


ATRASO				
	MOVLW	255
	MOVWF	CONTADOR1
ATRASO1	
		MOVLW	255
		MOVWF	CONTADOR2
	ATRASO2	
		MOVLW	11
		MOVWF	CONTADOR3
		ATRASO3	
			DECFSZ	CONTADOR3
			GOTO	ATRASO3	
		DECFSZ	CONTADOR2
		GOTO	ATRASO2	
	DECFSZ	CONTADOR1
	GOTO	ATRASO1	
	MOVLW	255
	MOVWF	CONTADOR4
FOR1
	MOVLW	125
	MOVWF	CONTADOR5
	FOR2	
		DECFSZ	CONTADOR5
		GOTO    FOR2	
	DECFSZ	CONTADOR4
	GOTO    FOR1				
	RETURN				


END